## configs/raspberrypi3b-plus_defconfig
```kconfig
BR2_aarch64=y
BR2_cortex_a53=y
BR2_ARM_FPU_VFPV4=y
BR2_TOOLCHAIN_BUILDROOT_CXX=y

BR2_SYSTEM_DHCP="eth0"

# Linux headers same as kernel, a 4.14 series
BR2_PACKAGE_HOST_LINUX_HEADERS_CUSTOM_4_14=y

BR2_LINUX_KERNEL=y
BR2_LINUX_KERNEL_CUSTOM_TARBALL=y
BR2_LINUX_KERNEL_CUSTOM_TARBALL_LOCATION="$(call github,raspberrypi,linux,4413b6e0a939a0713bb647571d1e537bd12294a2)/linux-4413b6e0a939a0713bb647571d1e537bd12294a2.tar.gz"
BR2_LINUX_KERNEL_DEFCONFIG="bcmrpi"

# Build the DTB from the kernel sources
BR2_LINUX_KERNEL_DTS_SUPPORT=y
# BR2_LINUX_KERNEL_INTREE_DTS_NAME="broadcom/bcm2710-rpi-3-b broadcom/bcm2710-rpi-3-b-plus broadcom/bcm2837-rpi-3-b"
BR2_LINUX_KERNEL_INTREE_DTS_NAME="broadcom/bcm2710-rpi-3-b-plus"

BR2_PACKAGE_RPI_FIRMWARE=y
# BR2_PACKAGE_RPI_FIRMWARE_INSTALL_DTB_OVERLAYS is not set

# Required tools to create the SD image
BR2_PACKAGE_HOST_DOSFSTOOLS=y
BR2_PACKAGE_HOST_GENIMAGE=y
BR2_PACKAGE_HOST_MTOOLS=y

# Filesystem / image
BR2_TARGET_ROOTFS_EXT2=y
BR2_TARGET_ROOTFS_EXT2_4=y
# BR2_TARGET_ROOTFS_EXT2_SIZE="120M"
# BR2_TARGET_ROOTFS_TAR is not set
BR2_ROOTFS_POST_BUILD_SCRIPT="board/raspberrypi3-64/post-build.sh"
# BR2_ROOTFS_POST_IMAGE_SCRIPT="board/raspberrypi3-64/post-image.sh"
# BR2_ROOTFS_POST_SCRIPT_ARGS="--aarch64"


# ---------------------------------------------------------------------------
# Above, is the upstream defconfig, with any conflicting lines commented out.
# KubOS overrides/replacements and other customizations are below.
# ---------------------------------------------------------------------------


BR2_KUBOS_VERSION="1.21.0"

BR2_BINUTILS_VERSION_2_31_X=y
BR2_GCC_ENABLE_LTO=y
# BR2_GLOBAL_PATCH_DIR="${BR2_EXTERNAL_KUBOS_LINUX_PATH}/common/patches"
BR2_HOST_DIR="$(TOPDIR)/../rpi-3b-plus-build-output"
BR2_TAR_OPTIONS="--no-same-owner"
BR2_TOOLCHAIN_BUILDROOT_GLIBC=y

BR2_TARGET_GENERIC_HOSTNAME="Kubos"
BR2_TARGET_GENERIC_ISSUE="Welcome to Kubos Linux"
BR2_TARGET_GENERIC_ROOT_PASSWD="Kubos123"
BR2_TARGET_GENERIC_GETTY_PORT="ttyAMA0"
BR2_TARGET_GENERIC_GETTY_BAUDRATE_115200=y

BR2_TARGET_ROOTFS_EXT2_LABEL="rootfs"
BR2_TARGET_ROOTFS_EXT2_SIZE="128M"
BR2_TARGET_ROOTFS_TAR_LZMA=y

BR2_TARGET_UBOOT=y
BR2_TARGET_UBOOT_BUILD_SYSTEM_KCONFIG=y
BR2_TARGET_UBOOT_CUSTOM_GIT=y
BR2_TARGET_UBOOT_CUSTOM_REPO_URL="https://github.com/u-boot/u-boot"
BR2_TARGET_UBOOT_CUSTOM_REPO_VERSION="master"
BR2_TARGET_UBOOT_USE_CUSTOM_CONFIG=y
BR2_TARGET_UBOOT_CUSTOM_CONFIG_FILE="${BR2_EXTERNAL_KUBOS_LINUX_PATH}/board/kubos/raspberrypi-3b-plus/raspberrypi3b-plus_config"
BR2_TARGET_UBOOT_FORMAT_IMG=y

BR2_ROOTFS_DEVICE_TABLE="system/device_table.txt $(BR2_EXTERNAL)/common/device_table.txt"
BR2_ROOTFS_DEVICE_CREATION_DYNAMIC_EUDEV=y
BR2_ROOTFS_USERS_TABLES="${BR2_EXTERNAL_KUBOS_LINUX_PATH}/common/users.txt"
BR2_ROOTFS_OVERLAY="$(BR2_EXTERNAL)/common/overlay $(BR2_EXTERNAL)/board/kubos/raspberrypi-3b-plus/overlay"
BR2_ROOTFS_POST_IMAGE_SCRIPT="${BR2_EXTERNAL_KUBOS_LINUX_PATH}/board/kubos/raspberrypi-3b-plus/post-image.sh"
BR2_ROOTFS_POST_SCRIPT_ARGS="${BR2_TARGET_UBOOT_CUSTOM_REPO_VERSION}"

BR2_LINUX_KERNEL_USE_CUSTOM_CONFIG=y
BR2_LINUX_KERNEL_CUSTOM_CONFIG_FILE="${BR2_EXTERNAL_KUBOS_LINUX_PATH}/board/kubos/raspberrypi-3b-plus/linux-kubos.config"
BR2_LINUX_KERNEL_CONFIG_FRAGMENT_FILES="${BR2_EXTERNAL_KUBOS_LINUX_PATH}/common/linux-kubos.config"
#BR2_LINUX_KERNEL_CUSTOM_DTS_PATH="${BR2_EXTERNAL_KUBOS_LINUX_PATH}/board/kubos/raspberrypi-3b-plus/bcm2710-rpi-3-b.dts ${BR2_EXTERNAL_KUBOS_LINUX_PATH}/board/kubos/raspberrypi-3b-plus/bcm2710-rpi-3-b-plus.dts ${BR2_EXTERNAL_KUBOS_LINUX_PATH}/board/kubos/raspberrypi-3b-plus/bcm2837-rpi-3-b.dts"
BR2_LINUX_KERNEL_NEEDS_HOST_OPENSSL=y
BR2_LINUX_KERNEL_LZ4=y

BR2_PACKAGE_BUSYBOX_CONFIG="${BR2_EXTERNAL_KUBOS_LINUX_PATH}/common/busybox-kubos.config"
BR2_PACKAGE_BUSYBOX_SHOW_OTHERS=y
BR2_PACKAGE_GDB=y
BR2_PACKAGE_GDB_SERVER=y
BR2_PACKAGE_GDB_DEBUGGER=y
BR2_PACKAGE_GDB_TUI=y
BR2_PACKAGE_PV=y
BR2_PACKAGE_DOSFSTOOLS=y
BR2_PACKAGE_DOSFSTOOLS_FSCK_FAT=y
BR2_PACKAGE_E2FSPROGS=y
BR2_PACKAGE_E2FSPROGS_DEBUGFS=y
BR2_PACKAGE_SPI_TOOLS=y
BR2_PACKAGE_UBOOT_TOOLS=y
BR2_PACKAGE_UBOOT_TOOLS_FIT_SUPPORT=y
BR2_PACKAGE_UBOOT_TOOLS_MKIMAGE=y
BR2_PACKAGE_PYTHON3=y
BR2_PACKAGE_PYTHON_NUMPY=y
BR2_PACKAGE_PYTHON_SERIAL=y
BR2_PACKAGE_PYTHON_SETUPTOOLS=y
BR2_PACKAGE_PYTHON_SMBUS_CFFI=y
BR2_PACKAGE_PYTHON_SPIDEV=y
BR2_PACKAGE_PIGPIO=y
BR2_PACKAGE_PYTHON_PIGPIO=y
BR2_PACKAGE_LIBCURL=y
BR2_PACKAGE_CURL=y
BR2_PACKAGE_DROPBEAR=y
BR2_PACKAGE_DROPBEAR_DISABLE_REVERSEDNS=y
BR2_PACKAGE_IFTOP=y
BR2_PACKAGE_LRZSZ=y
BR2_PACKAGE_MONIT=y
BR2_PACKAGE_RSYSLOG=y
BR2_PACKAGE_UTIL_LINUX_LIBFDISK=y
BR2_PACKAGE_UTIL_LINUX_MOUNT=y
BR2_PACKAGE_UTIL_LINUX_UUIDD=y
BR2_PACKAGE_LIBUSB=y
BR2_PACKAGE_LIBUSB_COMPAT=y
BR2_PACKAGE_USBUTILS=y
BR2_PACKAGE_EUDEV=y
BR2_PACKAGE_KUBOS_SERVICE_LIB=y
BR2_PACKAGE_KUBOS_CORE=y
BR2_PACKAGE_HOST_UBOOT_TOOLS_MKIMAGE=y
BR2_PACKAGE_HOST_GENEXT2FS=y
BR2_PACKAGE_HOST_GDB=y
BR2_PACKAGE_HOST_GDB_SIM=y
```
